## ports/zephyr-cp/boards/stm32wba65i_dk1.conf
```kconfig
# USB OTG on STM32WBA requires VOS Range 1. Keep HCLK > 16 MHz.
CONFIG_SYS_CLOCK_HW_CYCLES_PER_SEC=32000000

# Bluetooth doesn't start up for some reason.
# CONFIG_BT=y
# CONFIG_BT_PERIPHERAL=y
# CONFIG_BT_CENTRAL=y
CONFIG_BT_BROADCASTER=y
CONFIG_BT_OBSERVER=y
CONFIG_BT_EXT_ADV=y
CONFIG_BT_STM32WBA_USE_TEMP_BASED_CALIB=n

CONFIG_BT_DEVICE_APPEARANCE_DYNAMIC=y
CONFIG_BT_DEVICE_NAME_DYNAMIC=y
CONFIG_BT_DEVICE_NAME_MAX=28
CONFIG_BT_L2CAP_TX_MTU=253

# BT Buffers
CONFIG_BT_BUF_CMD_TX_SIZE=255
CONFIG_BT_BUF_EVT_RX_COUNT=16
CONFIG_BT_BUF_EVT_RX_SIZE=255
CONFIG_BT_BUF_ACL_TX_SIZE=251
CONFIG_BT_BUF_ACL_RX_COUNT_EXTRA=1
CONFIG_BT_BUF_ACL_RX_SIZE=255
```

## ports/zephyr-cp/zephyr-config/west.yml
```yaml
manifest:
  group-filter:
    - +babblesim
  projects:
    - name: nrf_hw_models
      url: https://github.com/tannewt/ext_nRF_hw_models
      revision: c2927847bdf2ee0af9c5459f4155c67f39f6837a
      path: modules/bsim_hw_models/nrf_hw_models
    - name: zephyr
      url: https://github.com/adafruit/zephyr
      revision: 589b2139926017d4d98724bac653ceb30802be9f
      clone-depth: 100
      import: true
```
